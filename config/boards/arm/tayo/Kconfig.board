## config/boards/arm/tayo/Kconfig.board
```kconfig
# Zaphod board configuration

# Copyright (c) 2020 Pete Johanson
# SPDX-License-Identifier: MIT

config BOARD_TAYO
	bool "tayo"
	depends on SOC_NRF52840_QIAA
```

## config/boards/arm/tayo/Kconfig.defconfig
```kconfig
# Copyright (c) 2020 Pete Johanson
# SPDX-License-Identifier: MIT

if BOARD_TAYO

config BOARD
	default "tayo"

config ZMK_KEYBOARD_NAME
	default "Tayo (Rable88)"

if USB

config USB_NRFX
	default y

config USB_DEVICE_STACK
	default y

endif # USB

config SPI
	default y

config BT_CTLR
	default BT

config ZMK_BLE
	default y

config ZMK_USB
	default y

config ZMK_BATTERY_VOLTAGE_DIVIDER
	default y

endif # BOARD_TAYO
```

## config/boards/arm/tayo/tayo_defconfig
```kconfig
# SPDX-License-Identifier: MIT

CONFIG_SOC_SERIES_NRF52X=y
CONFIG_SOC_NRF52840_QIAA=y

# Enable MPU
CONFIG_ARM_MPU=y

# enable GPIO
CONFIG_GPIO=y

CONFIG_ZMK_SLEEP=y

CONFIG_USE_DT_CODE_PARTITION=y

CONFIG_MPU_ALLOW_FLASH_WRITE=y
CONFIG_NVS=y
CONFIG_SETTINGS_NVS=y
CONFIG_FLASH=y
CONFIG_FLASH_PAGE_LAYOUT=y
CONFIG_FLASH_MAP=y

# Enable Encoders
CONFIG_EC11=y
CONFIG_EC11_TRIGGER_GLOBAL_THREAD=y

# Enable underglow
CONFIG_ZMK_RGB_UNDERGLOW=n
CONFIG_WS2812_STRIP=n

# Allow toggling underglow without toggling external power
CONFIG_ZMK_RGB_UNDERGLOW_EXT_POWER=y

# External power control to save battery
CONFIG_ZMK_EXT_POWER=y

# Increase BLE power level
CONFIG_BT_CTLR_TX_PWR_PLUS_8=n

# Enable .uf2 build
CONFIG_BUILD_OUTPUT_UF2=y

# Turn on logging, and set ZMK logging to debug output
CONFIG_ZMK_USB_LOGGING=y
CONFIG_ZMK_LOG_LEVEL_DBG=y
CONFIG_DEBUG=n

CONFIG_ZMK_BLE_CLEAR_BONDS_ON_START=n
CONFIG_USB_HID_BOOT_PROTOCOL=y
```

## config/west.yml
```yaml
manifest:
  remotes:
    - name: zmkfirmware
      url-base: https://github.com/zmkfirmware
    - name: rizalfr
      url-base: https://github.com/rizalfr
  projects:
    - name: zmk
      remote: rizalfr
      revision: core/zephyr-v3.5
      import: app/west.yml
  self:
    path: config
```
